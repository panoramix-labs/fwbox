## west.yml
```yaml
# Copyright (c) 2024 Panoramix Labs
# SPDX-License-Identifier: Apache-2.0

manifest:
  self:
    west-commands: zephyr/scripts/west-commands.yml

  remotes:
    - name: zephyrproject-rtos
      url-base: https://github.com/zephyrproject-rtos

  projects:
    - name: zephyr
      remote: zephyrproject-rtos
      revision: main
      import:
        name-allowlist:
          - cmsis
          - hal_stm32
```
